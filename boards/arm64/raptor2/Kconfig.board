## boards/arm64/raptor2/Kconfig.board
```kconfig
# SPDX-License-Identifier: Apache-2.0
# Copyright 2021 EdgeQ Inc.

config BOARD_EDGEQ_RAPTOR2
	bool "EdgeQ Raptor2 Board"
	depends on SOC_EDGEQ_RAPTOR2
	select ARM64
	select BOOT_BANNER

config BOARD_EDGEQ_RAPTOR2_SOCFM
	bool "EdgeQ Raptor2 SOCFM"
	depends on BOARD_EDGEQ_RAPTOR2
	default n

config BOARD_EDGEQ_RAPTOR2_PROTIUM
	bool "EdgeQ Raptor2 Protium"
	depends on BOARD_EDGEQ_RAPTOR2
	default n

config BOARD_EDGEQ_RAPTOR2_PROTIUM_SINGLE_PPU
	bool "EdgeQ Raptor2 Protium"
	depends on BOARD_EDGEQ_RAPTOR2
	default n
```

## boards/arm64/raptor2/Kconfig.defconfig
```kconfig
# SPDX-License-Identifier: Apache-2.0
# Copyright 2021 EdgeQ Inc.

if BOARD_EDGEQ_RAPTOR2

config BUILD_OUTPUT_BIN
	default y if XIP

config BOARD
	default "raptor2"

config SHARED_MEM_BASE_ADDRESS
	hex "Shared Memory Base Address"
	default 0x0

config SHARED_MEM_SIZE
	int "Shared Memory Size in kB"
	default 4

endif # BOARD_EDGEQ_RAPTOR2
```

## boards/arm64/raptor2/raptor2_a0_defconfig
```kconfig
CONFIG_SOC_EDGEQ_RAPTOR2=y
CONFIG_BOARD_EDGEQ_RAPTOR2=y
CONFIG_BOARD_EDGEQ_RAPTOR2_A0=y
CONFIG_ARM_ARCH_TIMER=y
CONFIG_SYS_CLOCK_HW_CYCLES_PER_SEC=40000000
CONFIG_XIP=n
CONFIG_FLASH_BASE_ADDRESS=0x0
CONFIG_FLASH_SIZE=0
CONFIG_AARCH64_IMAGE_HEADER=y
CONFIG_MAX_XLAT_TABLES=50
CONFIG_ARM64_VA_BITS_48=y
CONFIG_ARM64_PA_BITS_48=y

# Enable UART driver
CONFIG_SERIAL=y

# Enable console
CONFIG_CONSOLE=y
CONFIG_UART_CONSOLE=y
CONFIG_PRINTK=y
CONFIG_EARLY_CONSOLE=y
CONFIG_BOOT_BANNER=y

# PSCI is supported
CONFIG_PM_CPU_OPS=y
CONFIG_PM_CPU_OPS_PSCI=y

# Enable serial port
#CONFIG_UART_PL011=y
#CONFIG_UART_PL011_PORT0=y
#CONFIG_UART_INTERRUPT_DRIVEN=y
CONFIG_UART_NS16550=y
CONFIG_UART_NS16550_ACCESS_WORD_ONLY=y
CONFIG_SHELL_BACKEND_SERIAL_INTERRUPT_DRIVEN=n

CONFIG_SMP=y
CONFIG_MP_NUM_CPUS=12
CONFIG_CACHE_MANAGEMENT=y
CONFIG_TIMEOUT_64BIT=y
CONFIG_ARMV8_A_NS=y

CONFIG_KERNEL_MEM_POOL=y

CONFIG_HEAP_MEM_POOL_SIZE=8192
CONFIG_POLL=y

CONFIG_INIT_STACKS=y
CONFIG_BOOT_BANNER=y
CONFIG_BOOT_DELAY=0
CONFIG_THREAD_MONITOR=y
CONFIG_THREAD_NAME=y
CONFIG_THREAD_MAX_NAME_LEN=32
CONFIG_SHELL=y
```

## boards/arm64/raptor2/raptor2_defconfig
```kconfig
CONFIG_SOC_EDGEQ_RAPTOR2=y
CONFIG_BOARD_EDGEQ_RAPTOR2=y
CONFIG_ARM_ARCH_TIMER=y
CONFIG_XIP=n
CONFIG_FLASH_BASE_ADDRESS=0x0
CONFIG_FLASH_SIZE=0
CONFIG_AARCH64_IMAGE_HEADER=y
CONFIG_MAX_XLAT_TABLES=10
CONFIG_ARM64_VA_BITS_48=y
CONFIG_ARM64_PA_BITS_48=y

# Enable UART driver
CONFIG_SERIAL=y

# Enable console
CONFIG_CONSOLE=y
CONFIG_UART_CONSOLE=y

# PSCI is supported
CONFIG_PM_CPU_OPS=y
CONFIG_PM_CPU_OPS_PSCI=y

# Enable serial port
CONFIG_UART_PL011=y
CONFIG_UART_PL011_PORT0=y
CONFIG_UART_INTERRUPT_DRIVEN=y

CONFIG_SMP=y
CONFIG_MP_NUM_CPUS=2
CONFIG_CACHE_MANAGEMENT=y
CONFIG_TIMEOUT_64BIT=y
CONFIG_ARMV8_A_NS=y
```

## drivers/misc/raptor2/Kconfig
```kconfig
config RAPTOR2_DOORBELL
	bool "Enable Raptor2 Doorbell Mechanism"
	default n
	help
	  Enable interrupt doorbell mechanism.
```

## dts/bindings/misc/raptor2,doorbell.yaml
```yaml
description: RAPTOR2 DOORBELL

compatible: "raptor2,doorbell"

include: base.yaml

properties:
    reg:
      required: true

    interrupts:
      required: true

    rbell-irq:
      type: int
      required: true
      description: remote irq number for Linux

    cpu-affinity:
      type: int
      default: 0
      required: false
      description: cpu number to set irq affinity (should be less than CONFIG_MP_NUM_CPUS)
```

## soc/arm64/raptor2/Kconfig.defconfig
```kconfig
# SPDX-License-Identifier: Apache-2.0
# Copyright 2021 EdgeQ Inc.
#

if SOC_EDGEQ_RAPTOR2

config SOC
	default "raptor2"

config NUM_IRQS
	# must be >= the highest interrupt number used
	# - include the UART interrupts
	default 1024

config SYS_CLOCK_HW_CYCLES_PER_SEC
	default 10000000

endif # SOC_EDGEQ_RAPTOR2
```

## soc/arm64/raptor2/Kconfig.soc
```kconfig
# SPDX-License-Identifier: Apache-2.0
# Copyright 2021 EdgeQ Inc.

config SOC_EDGEQ_RAPTOR2
	bool "EdgeQ Raptor2"
	select ARM64
	select CPU_NEOVERSE_E1
	select ARM_ARCH_TIMER
	select GIC_V3
```
